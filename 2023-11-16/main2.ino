// generated by mBlock5 for mBot
// codes make you happy

#include <MeMCore.h>
#include <Arduino.h>
#include <Wire.h>
#include <SoftwareSerial.h>

MeLineFollower linefollower_2(2);
MeDCMotor motor_9(9);
MeDCMotor motor_10(10);

void _delay(float seconds) {
  long endTime = millis() + seconds * 1000;
  while(millis() < endTime) _loop();
}

void setup() {
  while(1) {
      if(((0 ? (1 == 0 ? linefollower_2.readSensors() == 0 :
      (linefollower_2.readSensors() & 1) == 1) :
      (1 == 0 ? linefollower_2.readSensors() == 3 :
      (linefollower_2.readSensors() & 1) == 0)))  &&  ((0 ? (2 == 0 ? linefollower_2.readSensors() == 0 :
      (linefollower_2.readSensors() & 2) == 2) :
      (2 == 0 ? linefollower_2.readSensors() == 3 :
      (linefollower_2.readSensors() & 2) == 0)))){

          motor_9.run(-1 * 50/100.0*255);
          motor_10.run(50/100.0*255);

      }else{
          if((1 ? (1 == 0 ? linefollower_2.readSensors() == 0 :
          (linefollower_2.readSensors() & 1) == 1) :
          (1 == 0 ? linefollower_2.readSensors() == 3 :
          (linefollower_2.readSensors() & 1) == 0))){

              motor_9.run(-1 * 5/100.0*255);
              motor_10.run(80/100.0*255);

          }else{
              if((1 ? (2 == 0 ? linefollower_2.readSensors() == 0 :
              (linefollower_2.readSensors() & 2) == 2) :
              (2 == 0 ? linefollower_2.readSensors() == 3 :
              (linefollower_2.readSensors() & 2) == 0))){

                  motor_9.run(-1 * 80/100.0*255);
                  motor_10.run(5/100.0*255);

              }else{

                  motor_9.run(-1 * 50/100.0*255);
                  motor_10.run(50/100.0*255);

              }

          }

      }

      _loop();
  }

}

void _loop() {
}

void loop() {
  _loop();
}

