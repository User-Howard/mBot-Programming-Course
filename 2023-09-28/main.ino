// generated by mBlock5 for mBot
// codes make you happy

#include <MeMCore.h>
#include <Arduino.h>
#include <Wire.h>
#include <SoftwareSerial.h>

double currentTime = 0;
double lastTime = 0;
MeDCMotor motor_9(9);
MeDCMotor motor_10(10);

double getLastTime(){
  return currentTime = millis() / 1000.0 - lastTime;
}

void _delay(float seconds) {
  long endTime = millis() + seconds * 1000;
  while(millis() < endTime) _loop();
}

void setup() {
  lastTime = millis() / 1000.0;
  while(!(getLastTime() > 0.5))
  {
    _loop();
  }
  lastTime = millis() / 1000.0;
  while(!(getLastTime() > 11.5))
  {
    _loop();

    motor_9.run(-1 * 90/100.0*255);
    motor_10.run(92/100.0*255);

  }
  motor_9.run(0);
  motor_10.run(0);

}

void _loop() {
}

void loop() {
  _loop();
}

