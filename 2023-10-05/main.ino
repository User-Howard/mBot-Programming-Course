// generated by mBlock5 for mBot
// codes make you happy

#include <MeMCore.h>
#include <Arduino.h>
#include <Wire.h>
#include <SoftwareSerial.h>

MeIR ir;
MeDCMotor motor_9(9);
MeDCMotor motor_10(10);

void move(int direction, int speed) {
  int leftSpeed = 0;
  int rightSpeed = 0;
  if(direction == 1) {
    leftSpeed = speed;
    rightSpeed = speed;
  } else if(direction == 2) {
    leftSpeed = -speed;
    rightSpeed = -speed;
  } else if(direction == 3) {
    leftSpeed = -speed;
    rightSpeed = speed;
  } else if(direction == 4) {
    leftSpeed = speed;
    rightSpeed = -speed;
  }
  motor_9.run((9) == M1 ? -(leftSpeed) : (leftSpeed));
  motor_10.run((10) == M1 ? -(rightSpeed) : (rightSpeed));
}

void _delay(float seconds) {
  long endTime = millis() + seconds * 1000;
  while(millis() < endTime) _loop();
}

void setup() {
  ir.begin();
  while(!(ir.keyPressed(70)))
  {
    _loop();
  }
  for(int count=0;count<6;count++){

      move(1, 100 / 100.0 * 255);
      _delay(0.3);
      move(1, 0);

      move(4, 50 / 100.0 * 255);
      _delay(0.5);
      move(4, 0);
      _delay(0.05);
  }
  while(1) {
      while(!(ir.keyPressed(13)))
      {
        _loop();
      }

      move(2, 90 / 100.0 * 255);
      _delay(1);
      move(2, 0);

      move(1, 80 / 100.0 * 255);
      _delay(2);
      move(1, 0);

      move(4, 100 / 100.0 * 255);
      _delay(1);
      move(4, 0);

      move(2, 90 / 100.0 * 255);
      _delay(1);
      move(2, 0);

      move(1, 80 / 100.0 * 255);
      _delay(1);
      move(1, 0);

      move(4, 100 / 100.0 * 255);
      _delay(1);
      move(4, 0);

      move(2, 90 / 100.0 * 255);
      _delay(1);
      move(2, 0);

      move(1, 80 / 100.0 * 255);
      _delay(2);
      move(1, 0);

      _loop();
  }

}

void _loop() {
  ir.loop();
}

void loop() {
  _loop();
}
