// generated by mBlock5 for mBot
// codes make you happy

#include <MeMCore.h>
#include <Arduino.h>
#include <Wire.h>
#include <SoftwareSerial.h>

MeUltrasonicSensor ultrasonic_3(3);
MeDCMotor motor_9(9);
MeDCMotor motor_10(10);

void move(int direction, int speed) {
  int leftSpeed = 0;
  int rightSpeed = 0;
  if(direction == 1) {
    leftSpeed = speed;
    rightSpeed = speed;
  } else if(direction == 2) {
    leftSpeed = -speed;
    rightSpeed = -speed;
  } else if(direction == 3) {
    leftSpeed = -speed;
    rightSpeed = speed;
  } else if(direction == 4) {
    leftSpeed = speed;
    rightSpeed = -speed;
  }
  motor_9.run((9) == M1 ? -(leftSpeed) : (leftSpeed));
  motor_10.run((10) == M1 ? -(rightSpeed) : (rightSpeed));
}

void _delay(float seconds) {
  long endTime = millis() + seconds * 1000;
  while(millis() < endTime) _loop();
}

void setup() {
  while (true) {
    int distance = ultrasonic_3.distanceCm(); // 獲取距離

    if (distance > 10) {
      // 將距離線性映射到速度範圍
      int speed = map(distance+20, 10, 100, 0, 255);

      // 限制速度在0到255之間
      speed = constrain(speed, 0, 255);

      move(1, speed); // 前進，速度根據距離動態調整
    } else if(distance > 5){
      motor_9.run(0); // 停止左馬達
      motor_10.run(0); // 停止右馬達
    } else {
        move(2, 50 / 100.0 * 255);
    }
  
    _loop();
  }
}

void _loop() {
}

void loop() {
  _loop();
}
